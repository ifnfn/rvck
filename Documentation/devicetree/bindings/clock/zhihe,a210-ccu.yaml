## Documentation/devicetree/bindings/clock/zhihe,a210-ccu.yaml
```yaml
# SPDX-License-Identifier: (GPL-2.0-only OR BSD-2-Clause)
%YAML 1.2
---
$id: http://devicetree.org/schemas/clock/zhihe,a210-ccu.yaml#
$schema: http://devicetree.org/meta-schemas/core.yaml#

title: Zhihe A210 Clock Control Unit (CCU)

maintainers:
  - Zhiguo Zhu <zhiguo.zhu@linux.alibaba.com>

description:
  Clock control unit associated with a Zhihe A210 power domain. It
  configures clock gating/scaling delays that are applied when the
  parent power domain is powered on.

properties:
  compatible:
    const: zhihe,a210-ccu

  reg:
    minItems: 1
    maxItems: 8

  zhihe,ccu-mode:
    $ref: /schemas/types.yaml#/definitions/uint32
    description: CCU operating mode (0 = gating, 1 = scaling).

  zhihe,ccu-dly-time:
    $ref: /schemas/types.yaml#/definitions/uint32-array
    description: Per-CCU delay time value.

  zhihe,ccu-dly-time-step:
    $ref: /schemas/types.yaml#/definitions/uint32-array
    description: Per-CCU delay time step value.

  zhihe,ccu-ratio:
    $ref: /schemas/types.yaml#/definitions/uint32-array
    description: Per-CCU divider ratio (scaling mode only).

required:
  - compatible
  - reg
  - zhihe,ccu-dly-time
  - zhihe,ccu-dly-time-step

additionalProperties: false

examples:
  - |
    ccu@0 {
        compatible = "zhihe,a210-ccu";
        reg = <0x05910000 0x2c>, <0x05920000 0x2c>;
        zhihe,ccu-dly-time = <0x5e 0x5e>;
        zhihe,ccu-dly-time-step = <0x3 0x3>;
    };
```

## Documentation/devicetree/bindings/mailbox/zhihe,a210-mailbox.yaml
```yaml
# SPDX-License-Identifier: (GPL-2.0-only OR BSD-2-Clause)
%YAML 1.2
---
$id: http://devicetree.org/schemas/mailbox/zhihe,a210-mailbox.yaml#
$schema: http://devicetree.org/meta-schemas/core.yaml#

title: Zhihe A210 Mailbox Controller

maintainers:
  - Zhiguo Zhu <zhiguo.zhu@linux.alibaba.com>

description:
  Mailbox controller for the Zhihe A210 SoC providing inter-processor
  communication channels between the application processor and other
  cores such as the AON (Always-On) subsystem.

properties:
  compatible:
    const: zhihe,a210-mailbox

  reg:
    minItems: 1
    maxItems: 8

  reg-names:
    minItems: 1
    maxItems: 8
    items:
      enum:
        - interrupt_addr
        - local_addr0
        - local_addr1
        - remote_icu0
        - remote_icu1

  clocks:
    minItems: 1
    maxItems: 2

  resets:
    minItems: 1
    maxItems: 2

  interrupts:
    maxItems: 1

  icu_cpu_id:
    $ref: /schemas/types.yaml#/definitions/uint32
    description: Local ICU CPU index for this mailbox instance.

  version:
    $ref: /schemas/types.yaml#/definitions/uint32
    description: Mailbox hardware version (1 = V1, 2 = V2).

  "#mbox-cells":
    const: 2

required:
  - compatible
  - reg
  - reg-names
  - interrupts
  - "#mbox-cells"

additionalProperties: false

examples:
  - |
    #include <dt-bindings/interrupt-controller/irq.h>

    mailbox@321000 {
        compatible = "zhihe,a210-mailbox";
        reg = <0x00321000 0x1000>,
              <0x00320000 0x1000>,
              <0x00311000 0x1000>;
        reg-names = "interrupt_addr", "local_addr0", "remote_icu0";
        clocks = <&clk_peri 0>, <&clk_peri 1>;
        resets = <&rst 0>, <&rst 1>;
        interrupt-parent = <&intc>;
        interrupts = <336 IRQ_TYPE_LEVEL_HIGH>;
        icu_cpu_id = <0>;
        #mbox-cells = <2>;
        version = <1>;
    };
```

## Documentation/devicetree/bindings/pinctrl/zhihe,a210-pinctrl.yaml
```yaml
# SPDX-License-Identifier: (GPL-2.0-only OR BSD-2-Clause)
%YAML 1.2
---
$id: http://devicetree.org/schemas/pinctrl/zhihe,a210-pinctrl.yaml#
$schema: http://devicetree.org/meta-schemas/core.yaml#

title: Zhihe A210 Pin Controller

maintainers:
  - Zhiguo Zhu <zhiguo.zhu@linux.alibaba.com>

description:
  Pin controller for the Zhihe A210 SoC. The A210 has several pad
  controller instances (AON, PADCTRL0-2), each identified by a group id
  and providing pin multiplexing and configuration for its pad group.

properties:
  compatible:
    const: zhihe,a210-pinctrl

  reg:
    maxItems: 1

  clocks:
    maxItems: 1

  clock-names:
    items:
      - const: pclk

  zhihe,group-id:
    $ref: /schemas/types.yaml#/definitions/uint32
    description: Pad controller group index (0 = AON, 1-2 = PADCTRL1/2).

required:
  - compatible
  - reg
  - zhihe,group-id

additionalProperties: true

examples:
  - |
    pinctrl@30848000 {
        compatible = "zhihe,a210-pinctrl";
        reg = <0x30848000 0x2000>;
        clocks = <&aon_110m>;
        clock-names = "pclk";
        zhihe,group-id = <0>;
    };
```

## Documentation/devicetree/bindings/power/zhihe,a210-power-domain.yaml
```yaml
# SPDX-License-Identifier: (GPL-2.0-only OR BSD-2-Clause)
%YAML 1.2
---
$id: http://devicetree.org/schemas/power/zhihe,a210-power-domain.yaml#
$schema: http://devicetree.org/meta-schemas/core.yaml#

title: Zhihe A210 Power Domain Controller

maintainers:
  - Zhiguo Zhu <zhiguo.zhu@linux.alibaba.com>

description:
  Power domain controller for the Zhihe A210 SoC. It manages power
  gating of the various hardware subsystems through PCU/PPU units. Each
  power domain is described by a child node identified by an "id"
  property. Domains may reference IOPMP protection devices and contain
  clock control unit (ccu) subnodes.

properties:
  compatible:
    const: zhihe,a210-power-domain

  "#address-cells":
    const: 2

  "#size-cells":
    const: 2

  ranges: true

patternProperties:
  "^power[_-][a-z0-9]+$":
    type: object
    description: A single power domain provided by the controller.

    properties:
      "#power-domain-cells":
        const: 0

      "#address-cells":
        const: 2

      "#size-cells":
        const: 2

      ranges: true

      id:
        $ref: /schemas/types.yaml#/definitions/uint32
        description: Power domain identifier.

      iopmps:
        $ref: /schemas/types.yaml#/definitions/phandle-array
        description: IOPMP protection devices controlled with this domain.

      power-domains:
        maxItems: 1

      clocks:
        minItems: 1
        maxItems: 32

      resets:
        minItems: 1
        maxItems: 32

      pmic-supply:
        description: Regulator phandle powering this domain.

    patternProperties:
      "^ccu@[0-9a-f]+$":
        type: object
        description: Clock control unit associated with the domain.
        $ref: /schemas/clock/zhihe,ccu.yaml#

    required:
      - "#power-domain-cells"
      - id

    additionalProperties: false

required:
  - compatible

additionalProperties: false

examples:
  - |
    #include <dt-bindings/power/a210-power.h>

    a210-power-domain {
        compatible = "zhihe,a210-power-domain";
        #address-cells = <2>;
        #size-cells = <2>;
        ranges;

        power-top {
            #power-domain-cells = <0>;
            id = <A210_PD_TOP>;
        };
    };
```

## Documentation/devicetree/bindings/regulator/zhihe,a210-aon-regulator.yaml
```yaml
# SPDX-License-Identifier: (GPL-2.0-only OR BSD-2-Clause)
%YAML 1.2
---
$id: http://devicetree.org/schemas/regulator/zhihe,a210-aon-regulator.yaml#
$schema: http://devicetree.org/meta-schemas/core.yaml#

title: Zhihe A210 AON Regulator

maintainers:
  - Zhiguo Zhu <zhiguo.zhu@linux.alibaba.com>

description:
  Virtual regulator provider for the Zhihe A210 SoC. The regulators are
  physically controlled by the Always-On (AON) subsystem firmware and
  are accessed from the application processor over the AON mailbox.
  Each supported rail is described by a child node whose regulator-name
  identifies the corresponding AON virtual regulator.

properties:
  compatible:
    const: zhihe,a210-aon-regulator

patternProperties:
  ".*":
    type: object
    $ref: regulator.yaml#
    unevaluatedProperties: false

required:
  - compatible

additionalProperties: false

examples:
  - |
    regulators {
        compatible = "zhihe,a210-aon-regulator";

        dvdd_core {
            regulator-name = "dvdd_core";
            regulator-min-microvolt = <600000>;
            regulator-max-microvolt = <1000000>;
        };
    };
```

## Documentation/devicetree/bindings/reset/zhihe,a210-reset-controller.yaml
```yaml
# SPDX-License-Identifier: (GPL-2.0-only OR BSD-2-Clause)
%YAML 1.2
---
$id: http://devicetree.org/schemas/reset/zhihe,a210-reset-controller.yaml#
$schema: http://devicetree.org/meta-schemas/core.yaml#

title: Zhihe A210 Reset Controller

maintainers:
  - Zhiguo Zhu <zhiguo.zhu@linux.alibaba.com>

description:
  Reset controller for the Zhihe A210 SoC. It aggregates the reset
  registers of multiple subsystems, each described by a named register
  region, and exposes reset lines to consumers through the reset-cells
  interface.

properties:
  compatible:
    const: zhihe,a210-reset-controller

  reg:
    minItems: 1
    maxItems: 12

  reg-names:
    minItems: 1
    maxItems: 12
    items:
      enum:
        - VP_RST
        - VI_RST
        - NPU_RST
        - VO_RST
        - PERI0_RST
        - PERI1_RST
        - PERI2_RST
        - PERI3_RST
        - PCIE_RST
        - USB_RST
        - TEE_RST
        - GPU_RST

  "#reset-cells":
    const: 1

required:
  - compatible
  - reg
  - reg-names
  - "#reset-cells"

additionalProperties: false

examples:
  - |
    reset-controller {
        compatible = "zhihe,a210-reset-controller";
        reg = <0x06b20400 0x200>;
        reg-names = "VP_RST";
        #reset-cells = <1>;
    };
```

## Documentation/devicetree/bindings/riscv/zhihe.yaml
```yaml
# SPDX-License-Identifier: (GPL-2.0-only OR BSD-2-Clause)
%YAML 1.2
---
$id: http://devicetree.org/schemas/riscv/zhihe.yaml#
$schema: http://devicetree.org/meta-schemas/core.yaml#

title: Zhihe SoC-based boards

maintainers:
  - Zhiguo Zhu <zhiguo.zhu@linux.alibaba.com>

description:
  Zhihe SoC-based boards

properties:
  $nodename:
    const: '/'
  compatible:
    oneOf:
      - description: Boards based on the Zhihe A210 SoC
        items:
          - const: zhihe,a210

additionalProperties: true

...
```

## Documentation/devicetree/bindings/soc/zhihe/zhihe,a210-bmu.yaml
```yaml
# SPDX-License-Identifier: (GPL-2.0-only OR BSD-2-Clause)
%YAML 1.2
---
$id: http://devicetree.org/schemas/soc/zhihe/zhihe,a210-bmu.yaml#
$schema: http://devicetree.org/meta-schemas/core.yaml#

title: Zhihe A210 Bus Monitor Unit (BMU)

maintainers:
  - Zhiguo Zhu <zhiguo.zhu@linux.alibaba.com>

description:
  Bus Monitor Unit (BMU) of the Zhihe A210 SoC. Each subsystem (DDR,
  GPU, NPU, PCIe, USB, VO, VI, VP, PERI) has its own BMU instance used
  for bus performance monitoring and tracing.

properties:
  compatible:
    enum:
      - zhihe,a210-ddr-bmu
      - zhihe,a210-gpu-bmu
      - zhihe,a210-npu-bmu
      - zhihe,a210-pcie-bmu
      - zhihe,a210-usb-bmu
      - zhihe,a210-vo-bmu
      - zhihe,a210-vi-bmu
      - zhihe,a210-vp-bmu
      - zhihe,a210-peri-bmu

  interrupts:
    minItems: 1
    maxItems: 4
    description:
      Per-channel BMU interrupts, two per monitored register group.

  zhihe,bm-num:
    $ref: /schemas/types.yaml#/definitions/uint32
    description: Number of monitored register groups (ports).

  zhihe,bm-name:
    $ref: /schemas/types.yaml#/definitions/string
    description: Name of this BMU instance.

required:
  - compatible
  - zhihe,bm-num
  - zhihe,bm-name

additionalProperties: false

examples:
  - |
    bmu-ddr {
        compatible = "zhihe,a210-ddr-bmu";
        interrupts = <100>, <101>;
        zhihe,bm-num = <2>;
        zhihe,bm-name = "bmu_ddr";
    };
```

## Documentation/devicetree/bindings/soc/zhihe/zhihe,a210-memtester.yaml
```yaml
# SPDX-License-Identifier: (GPL-2.0-only OR BSD-2-Clause)
%YAML 1.2
---
$id: http://devicetree.org/schemas/soc/zhihe/zhihe,a210-memtester.yaml#
$schema: http://devicetree.org/meta-schemas/core.yaml#

title: Zhihe A210 DDR Memory Tester

maintainers:
  - Zhiguo Zhu <zhiguo.zhu@linux.alibaba.com>

description:
  Hardware DDR memory tester found on the Zhihe A210 SoC. It performs
  DMA-based read/write pattern tests against DDR memory to verify
  memory integrity.

properties:
  compatible:
    const: zhihe,a210-memtester

  reg:
    maxItems: 1

required:
  - compatible
  - reg

additionalProperties: false

examples:
  - |
    memtester@30860000 {
        compatible = "zhihe,a210-memtester";
        reg = <0x30860000 0x1000>;
    };
```

## drivers/clk/zhihe/Kconfig
```kconfig
# SPDX-License-Identifier: GPL-2.0

config ZHIHE_CLK
	bool
	def_bool ARCH_ZHIHE

config CLK_A210
	bool "Zhihe A210 Clock Driver"
	depends on ARCH_ZHIHE
	default n
	help
	  Build the clock controller driver for the ZhiHe A210 SoC.

	  This driver provides clock tree management including PLLs,
	  dividers, gates, and muxes for the A210 platform. Say Y if
	  you are building a kernel for the ZhiHe A210.
```

## drivers/phy/zhihe/Kconfig
```kconfig
# SPDX-License-Identifier: GPL-2.0-only

config PHY_ZHIHE_SNPS_USB2
	tristate "ZhiHe Synopsys USB 2.0 PHY driver"
	depends on (ARCH_ZHIHE && OF) || COMPILE_TEST
	depends on HAS_IOMEM
	select GENERIC_PHY
	default USB_DWC3 if ARCH_ZHIHE
	help
	  Enable this to support the ZHIHE Snps USB 2.0 PHY.
	  This driver provides PHY support for the USB 2.0 controllers
	  on ZHIHE platforms.

config PHY_ZHIHE_SNPS_C10PHY
	tristate "ZHIHE C10PHY USB3.1 PHY Driver"
	depends on ARCH_ZHIHE || COMPILE_TEST
	depends on HAS_IOMEM
	select GENERIC_PHY
	default USB_DWC3 if ARCH_ZHIHE
	help
	  Enable this to support the ZHIHE C10PHY USB3.1 PHY.
	  This PHY is used in ZHIHE A210 SoCs for USB 3.1 functionality.

	  To compile this driver as a module, choose M here: the
	  module will be called phy-c10phy.
```

## drivers/soc/zhihe/Kconfig
```kconfig
# SPDX-License-Identifier: GPL-2.0-only

menu "ZHIHE SoC drivers"

config A210_BMU
	tristate "A210 bmu driver"
	default n
	help
	  This driver provides support for the A210 Bus Monitor Unit
	  (BMU). It enables bus performance monitoring and tracing
	  for debugging and profiling purposes.
	  Say Y or M here if you need BMU bus monitoring support.

endmenu
```
